AUTOSAR XML (schema 4-3-0)
standard types defined: UINT32, SINT32, UINT16, SINT16, UINT8, SINT8
package /ETree/SYSTEM
  system System
package /ETree/CAN_DC_Motor
  can cluster CAN_Cluster: baudrate=250000, protocol-name=CAN, speed=250000
    can physical channel CAN_Channel: comm-connectors=[Connector_Main, Connector_Motor1, Connector_Motor2]
      frame PWM: id 0x100, from Main, to Motor1, frame-length=6, can-addressing-mode=STANDARD, can-frame-tx-behavior=CAN-20
        pdu PWM: length=6
      frame Position: id 0x101, from Main, to Motor1, frame-length=6, can-addressing-mode=STANDARD, can-frame-tx-behavior=CAN-20
        pdu Position: length=6
      frame Speed: id 0x102, from Main, to Motor1, frame-length=6, can-addressing-mode=STANDARD, can-frame-tx-behavior=CAN-20
        pdu Speed: length=6
      frame Status1: id 0x108, from Motor1, to Main, frame-length=8, can-addressing-mode=STANDARD, can-frame-tx-behavior=CAN-20
        pdu Status1: length=8
      frame Status2: id 0x109, from Motor1, to Main, frame-length=8, can-addressing-mode=STANDARD, can-frame-tx-behavior=CAN-20
        pdu Status2: length=8
      frame PWM: id 0x120, from Main, to Motor2, frame-length=6, can-addressing-mode=STANDARD, can-frame-tx-behavior=CAN-20
        carries pdu PDUS/PWM: packing-byte-order=little-endian, start-position=0
      frame Position: id 0x121, from Main, to Motor2, frame-length=6, can-addressing-mode=STANDARD, can-frame-tx-behavior=CAN-20
        carries pdu PDUS/Position: packing-byte-order=little-endian, start-position=0
      frame Speed: id 0x122, from Main, to Motor2, frame-length=6, can-addressing-mode=STANDARD, can-frame-tx-behavior=CAN-20
        carries pdu PDUS/Speed: packing-byte-order=little-endian, start-position=0
      frame Status1: id 0x128, from Motor2, to Main, frame-length=8, can-addressing-mode=STANDARD, can-frame-tx-behavior=CAN-20
        carries pdu PDUS/Status1: packing-byte-order=little-endian, start-position=0
      frame Status2: id 0x129, from Motor2, to Main, frame-length=8, can-addressing-mode=STANDARD, can-frame-tx-behavior=CAN-20
        carries pdu PDUS/Status2: packing-byte-order=little-endian, start-position=0
package /ETree/ECU_INSTANCES
  ecu instance Main
    can communication controller Controller_Main
    can communication connector Connector_Main: comm-controller=Controller_Main
  ecu instance Motor1
    can communication controller Controller_Motor1
    can communication connector Connector_Motor1: comm-controller=Controller_Motor1
  ecu instance Motor2
    can communication controller Controller_Motor2
    can communication connector Connector_Motor2: comm-controller=Controller_Motor2
package /ETree/FRAME
  5 x can frame:
    PWM: frame-length=6
      pdu to frame mapping PduToFrameMapping_PWM_PWM: packing-byte-order=little-endian, pdu=PDUS/PWM, start-position=0
    Position: frame-length=6
      pdu to frame mapping PduToFrameMapping_Position_Position: packing-byte-order=little-endian, pdu=PDUS/Position, start-position=0
    Speed: frame-length=6
      pdu to frame mapping PduToFrameMapping_Speed_Speed: packing-byte-order=little-endian, pdu=PDUS/Speed, start-position=0
    Status1: frame-length=8
      pdu to frame mapping PduToFrameMapping_Status1_Status1: packing-byte-order=little-endian, pdu=PDUS/Status1, start-position=0
    Status2: frame-length=8
      pdu to frame mapping PduToFrameMapping_Status2_Status2: packing-byte-order=little-endian, pdu=PDUS/Status2, start-position=0
package /ETree/PDUS
  pdu PWM: length=6
    signal Direction: start 0, 8 bit, little-endian, data-type-policy=OVERRIDE, base-type=SINT8, compu {phys=raw}, to Motor1 Main Motor2
    signal Duty: start 8, 8 bit, little-endian, data-type-policy=OVERRIDE, base-type=UINT8, compu {phys=raw}, to Motor1 Main Motor2
    signal none1: start 16, 16 bit, little-endian, data-type-policy=OVERRIDE, base-type=UINT16, compu {phys=raw}, to Motor1 Motor2
    signal Timeout: start 32, 16 bit, little-endian, data-type-policy=OVERRIDE, base-type=UINT16, compu {phys=raw}, to Motor1 Motor2
    signal Direction: start 0, 8 bit, little-endian, data-type-policy=OVERRIDE, base-type=SINT8, compu {phys=raw}, to Motor1 Main Motor2
    signal Duty: start 8, 8 bit, little-endian, data-type-policy=OVERRIDE, base-type=UINT8, compu {phys=raw}, to Motor1 Main Motor2
    signal none1: start 16, 16 bit, little-endian, data-type-policy=OVERRIDE, base-type=UINT16, compu {phys=raw}, to Motor1 Motor2
    signal Timeout: start 32, 16 bit, little-endian, data-type-policy=OVERRIDE, base-type=UINT16, compu {phys=raw}, to Motor1 Motor2
  pdu Position: length=6
    signal target_pos: start 0, 32 bit, little-endian, data-type-policy=OVERRIDE, base-type=SINT32, compu {phys=raw}, to Motor1 Motor2
    signal Timeout: start 32, 16 bit, little-endian, data-type-policy=OVERRIDE, base-type=UINT16, compu {phys=raw}, to Motor1 Motor2
    signal target_pos: start 0, 32 bit, little-endian, data-type-policy=OVERRIDE, base-type=SINT32, compu {phys=raw}, to Motor1 Motor2
    signal Timeout: start 32, 16 bit, little-endian, data-type-policy=OVERRIDE, base-type=UINT16, compu {phys=raw}, to Motor1 Motor2
  pdu Speed: length=6
    signal target_speed: start 0, 32 bit, little-endian, data-type-policy=OVERRIDE, base-type=SINT32, compu {phys=raw}, to Motor1 Motor2
    signal Timeout: start 32, 16 bit, little-endian, data-type-policy=OVERRIDE, base-type=UINT16, compu {phys=raw}, to Motor1 Motor2
    signal target_speed: start 0, 32 bit, little-endian, data-type-policy=OVERRIDE, base-type=SINT32, compu {phys=raw}, to Motor1 Motor2
    signal Timeout: start 32, 16 bit, little-endian, data-type-policy=OVERRIDE, base-type=UINT16, compu {phys=raw}, to Motor1 Motor2
  pdu Status1: length=8
    signal Direction: start 0, 8 bit, little-endian, data-type-policy=OVERRIDE, base-type=SINT8, compu {phys=raw}, to Motor1 Main Motor2
    signal Duty: start 8, 8 bit, little-endian, data-type-policy=OVERRIDE, base-type=UINT8, compu {phys=raw}, to Motor1 Main Motor2
    signal Mode: start 16, 8 bit, little-endian, data-type-policy=OVERRIDE, base-type=UINT8, compu {phys=raw}, to Main
    signal None2: start 24, 8 bit, little-endian, data-type-policy=OVERRIDE, base-type=UINT8, compu {phys=raw}, to Main
    signal Position: start 32, 32 bit, little-endian, data-type-policy=OVERRIDE, base-type=SINT32, compu {phys=raw}, to Main
    signal Direction: start 0, 8 bit, little-endian, data-type-policy=OVERRIDE, base-type=SINT8, compu {phys=raw}, to Motor1 Main Motor2
    signal Duty: start 8, 8 bit, little-endian, data-type-policy=OVERRIDE, base-type=UINT8, compu {phys=raw}, to Motor1 Main Motor2
    signal Mode: start 16, 8 bit, little-endian, data-type-policy=OVERRIDE, base-type=UINT8, compu {phys=raw}, to Main
    signal None2: start 24, 8 bit, little-endian, data-type-policy=OVERRIDE, base-type=UINT8, compu {phys=raw}, to Main
    signal Position: start 32, 32 bit, little-endian, data-type-policy=OVERRIDE, base-type=SINT32, compu {phys=raw}, to Main
  pdu Status2: length=8
    signal VBAT: start 0, 32 bit, little-endian, data-type-policy=OVERRIDE, base-type=IEEE754, compu {phys=raw}, to Main
    signal Target: start 32, 32 bit, little-endian, data-type-policy=OVERRIDE, base-type=SINT32, compu {phys=raw}, to Main
    signal VBAT: start 0, 32 bit, little-endian, data-type-policy=OVERRIDE, base-type=IEEE754, compu {phys=raw}, to Main
    signal Target: start 32, 32 bit, little-endian, data-type-policy=OVERRIDE, base-type=SINT32, compu {phys=raw}, to Main
package /ETree/I_SIGNALS
  19 x i signal, all with data-type-policy=OVERRIDE:
    Direction: length=8, base-type=SINT8, system-signal=SYSTEM_SIGNALS/Direction
    Duty: length=8, base-type=UINT8, system-signal=SYSTEM_SIGNALS/Duty
    none1: length=16, base-type=UINT16, system-signal=SYSTEM_SIGNALS/none1
    Timeout: length=16, base-type=UINT16, system-signal=SYSTEM_SIGNALS/Timeout
    target_pos: length=32, base-type=SINT32, system-signal=SYSTEM_SIGNALS/target_pos
    Timeout: length=16, base-type=UINT16, system-signal=SYSTEM_SIGNALS/Timeout
    target_speed: length=32, base-type=SINT32, system-signal=SYSTEM_SIGNALS/target_speed
    Timeout: length=16, base-type=UINT16, system-signal=SYSTEM_SIGNALS/Timeout
    Direction: length=8, base-type=SINT8, system-signal=SYSTEM_SIGNALS/Direction
    Duty: length=8, base-type=UINT8, system-signal=SYSTEM_SIGNALS/Duty
    Mode: length=8, base-type=UINT8, system-signal=SYSTEM_SIGNALS/Mode
    None2: length=8, base-type=UINT8, system-signal=SYSTEM_SIGNALS/None2
    Position: length=32, base-type=SINT32, system-signal=SYSTEM_SIGNALS/Position
    VBAT: length=32, base-type=IEEE754, system-signal=SYSTEM_SIGNALS/VBAT
    Target: length=32, base-type=SINT32, system-signal=SYSTEM_SIGNALS/Target
    Direction: length=8, base-type=SINT8, system-signal=SYSTEM_SIGNALS/Direction
    Duty: length=8, base-type=UINT8, system-signal=SYSTEM_SIGNALS/Duty
    Timeout: length=16, base-type=UINT16, system-signal=SYSTEM_SIGNALS/Timeout
    Timeout: length=16, base-type=UINT16, system-signal=SYSTEM_SIGNALS/Timeout
package /ETree/BASE_TYPES
  base type IEEE754: base-type-size=32, base-type-encoding=IEEE754
package /ETree/COMPUMETHODS
  compu method FACTOR_0_1: phys=raw*0.1
  compu method FACTOR_0_01: phys=raw*0.01
package /ETree/SYSTEM_SIGNALS
  19 x system signal, all with compu {phys=raw}:
    Direction
    Duty
    none1
    Timeout
    target_pos
    Timeout
    target_speed
    Timeout
    Direction
    Duty
    Mode
    None2
    Position
    VBAT
    Target
    Direction
    Duty
    Timeout
    Timeout
